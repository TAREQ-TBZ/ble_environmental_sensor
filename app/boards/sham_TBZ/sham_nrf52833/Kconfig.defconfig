## app/boards/sham_TBZ/sham_nrf52833/Kconfig.defconfig
```kconfig
# Copyright (c) 2024 Tareq Mhisen
# SPDX-License-Identifier: Apache-2.0

if BOARD_SHAM_NRF52833

config HW_STACK_PROTECTION
	default ARCH_HAS_STACK_PROTECTION

endif # BOARD_SHAM_NRF52833
```

## app/boards/sham_TBZ/sham_nrf52833/board.yml
```yaml
# Copyright (c) 2024 Tareq Mhisen
# SPDX-License-Identifier: Apache-2.0

board:
  name: sham_nrf52833
  full_name: SHAM Humidity Temperature Sensor
  vendor: sham_TBZ
  socs:
    - name: nrf52833
      variants:
        - name: nrf52833qiaa
```

## boards/arm/sham_nrf52833/Kconfig.defconfig
```kconfig
# Copyright (c) 2024 Tareq Mhisen

if BOARD_SHAM_NRF52833

config BT_CTLR
	default BT

endif # BOARD_SHAM_NRF52833
```

## boards/arm/sham_nrf52833/Kconfig.sham_nrf52833
```kconfig
# Copyright (c) 2024 Tareq Mhisen

config BOARD_SHAM_NRF52833
	select SOC_NRF52833_QDAA
```

## boards/arm/sham_nrf52833/board.yml
```yaml
# Copyright (c) 2024 Tareq Mhisen

board:
  name: sham_nrf52833
  vendor: sham_TBZ
  socs:
    - name: nrf52833
```

## boards/arm/sham_nrf52833/sham_nrf52833_defconfig
```kconfig
# Copyright (c) 2024 Tareq Mhisen

# Enable MPU
CONFIG_ARM_MPU=y

# Enable hardware stack protection
CONFIG_HW_STACK_PROTECTION=y

# Enable GPIO
CONFIG_GPIO=y
```

## boards/sham_TBZ/sham_nrf52833/Kconfig
```kconfig
# Copyright (c) 2024 Tareq Mhisen
# SPDX-License-Identifier: Apache-2.0

config BOARD_SHAM_NRF52833
	select SOC_NRF52833_QDAA
```

## boards/sham_TBZ/sham_nrf52833/Kconfig.defconfig
```kconfig
# Copyright (c) 2024 Tareq Mhisen
# SPDX-License-Identifier: Apache-2.0

if BOARD_SHAM_NRF52833

config BT_CTLR
	default BT

endif # BOARD_SHAM_NRF52833
```

## boards/sham_TBZ/sham_nrf52833/board.yml
```yaml
# Copyright (c) 2024 Tareq Mhisen
# SPDX-License-Identifier: Apache-2.0

board:
  name: sham_nrf52833
  vendor: sham_TBZ
  socs:
    - name: nrf52833
```

## west.yml
```yaml
manifest:
  self:
    path: application

  remotes:
    - name: zephyrproject-rtos
      url-base: https://github.com/zephyrproject-rtos

  projects:
    - name: zephyr
      remote: zephyrproject-rtos
      path: zephyr
      revision: v4.3.0
      import: true
```
